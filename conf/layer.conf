## conf/layer.conf
```bitbake
# We have a conf and classes directory, add to BBPATH
BBPATH .= ":${LAYERDIR}"

# We have recipes-* directories, add to BBFILES
BBFILES += "${LAYERDIR}/recipes-*/*/*.bb \
            ${LAYERDIR}/recipes-*/*/*.bbappend"

BBFILE_COLLECTIONS += "openbmc-nuvoton-addon"
BBFILE_PATTERN_openbmc-nuvoton-addon = "^${LAYERDIR}/"
BBFILE_PRIORITY_openbmc-nuvoton-addon = "7"
LAYERVERSION_openbmc-nuvoton-addon = "1"
```
